#include "everbe.dtsi"

&default_transform { 
    col-offset = <7>;
};

// these are the pins of the columns for the right half (should be the reverse of
// the left)
&kscan0 {
    col-gpios
        = <&pro_micro 2 GPIO_ACTIVE_HIGH>
        , <&pro_micro 7 GPIO_ACTIVE_HIGH>
        , <&pro_micro 6 GPIO_ACTIVE_HIGH>
        , <&pro_micro 5 GPIO_ACTIVE_HIGH>
        , <&pro_micro 4 GPIO_ACTIVE_HIGH>
        , <&pro_micro 3 GPIO_ACTIVE_HIGH>
        , <&pro_micro 9 GPIO_ACTIVE_HIGH>
        ;
};
