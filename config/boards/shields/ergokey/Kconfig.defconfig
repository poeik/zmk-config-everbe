## config/boards/shields/ergokey/Kconfig.defconfig
```kconfig
# Set configuration properties for either halves of the keyboards

# For the left halve:
# Define the left halve as BLE central
if SHIELD_ERGOKEY_LEFT

# Name must be less than 16 characters long!
config ZMK_KEYBOARD_NAME
    default "Ergokey"

config ZMK_SPLIT_ROLE_CENTRAL
    default y

endif

# for both halves
#
if SHIELD_ERGOKEY_LEFT || SHIELD_ERGOKEY_RIGHT

config ZMK_SPLIT
    default y

endif
```

## config/boards/shields/ergokey/Kconfig.shield
```kconfig
# define the shield names
# This sets two boolean properties (`SHIELD_ERGOKEY_LEFT` &
# `SHIELD_ERGOKEY_RIGHT`) which become `true` (`y`) whenever the `shields_list`
# contains `ergokey_left` or `ergokeyr_right` respecively.
#
# This lets us make specific configurations for both keyboard parts.

config SHIELD_ERGOKEY_LEFT
    def_bool $(shields_list_contains,ergokey_left)

config SHIELD_ERGOKEY_RIGHT
    def_bool $(shields_list_contains,ergokey_right)
```

## config/boards/shields/everbe/Kconfig.defconfig
```kconfig
# Set configuration properties for either halves of the keyboards

# For the left halve:
# Define the left halve as BLE central
if SHIELD_EVERBE_LEFT

# Name must be less than 16 characters long!
config ZMK_KEYBOARD_NAME
    default "Everbe"

config ZMK_SPLIT_ROLE_CENTRAL
    default y

endif

# for both halves
#
if SHIELD_EVERBE_LEFT || SHIELD_EVERBE_RIGHT

config ZMK_SPLIT
    default y

endif
```

## config/boards/shields/everbe/Kconfig.shield
```kconfig
# define the shield names
# This sets two boolean properties (`SHIELD_EVERBE_LEFT` &
# `SHIELD_EVERBE_RIGHT`) which become `true` (`y`) whenever the `shields_list`
# contains `everbe_left` or `everber_right` respecively.
#
# This lets us make specific configurations for both keyboard parts.

config SHIELD_EVERBE_LEFT
    def_bool $(shields_list_contains,everbe_left)

config SHIELD_EVERBE_RIGHT
    def_bool $(shields_list_contains,everbe_right)
```
